#include	"KTH71.h"

uint8_t CRC8Table[256]={
0x00, 0x07, 0x0e, 0x09, 0x1c, 0x1b, 0x12, 0x15, 0x38, 0x3f, 0x36, 0x31, 0x24, 0x23, 0x2a, 0x2d,
0x70, 0x77, 0x7e, 0x79, 0x6c, 0x6b, 0x62, 0x65, 0x48, 0x4f, 0x46, 0x41, 0x54, 0x53, 0x5a, 0x5d,
0xe0, 0xe7, 0xee, 0xe9, 0xfc, 0xfb, 0xf2, 0xf5, 0xd8, 0xdf, 0xd6, 0xd1, 0xc4, 0xc3, 0xca, 0xcd,
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0xde, 0xd9, 0xd0, 0xd7, 0xc2, 0xc5, 0xcc, 0xcb, 0xe6, 0xe1, 0xe8, 0xef, 0xfa, 0xfd, 0xf4, 0xf3
};

static uint8_t KTH71_IsCRCOK(uint8_t *pbuf, uint8_t buflen)
{
  uint8_t crc = 0x00;
  uint8_t i;
  for (i = 0; i < buflen - 1; i++)
  {
    crc = CRC8Table[crc ^ pbuf[i]];
  }
  crc = crc ^ 0x55;
  
  return (crc == pbuf[buflen - 1]) ? 1 : 0;
}
static void KTH71_SPI_TransmitReceive(uint8_t *pTxData, uint8_t *pRxData, uint8_t txLen, uint8_t rxLen)
{
		SPI_DMA_HalfDuplex_TxStartAsync(pTxData, txLen);
		while(!SPI_DMA_IsDone());  
		SPI_DMA_HalfDuplex_RxStartAsync(pRxData, rxLen);
		while(!SPI_DMA_IsDone());   
}
void KTH71_UnlockReg(void)
{
  uint8_t dataSend[4] = {0x20, 0x24, 0x01, 0x01};
  SPI_DMA_HalfDuplex_TxStartAsync(dataSend, 4);
	while(!SPI_DMA_IsDone()); 
}

void KTH71_LockReg(void)
{
  uint8_t dataSend[4] = {0x20, 0x24, 0x12, 0x31};
  SPI_DMA_HalfDuplex_TxStartAsync(dataSend, 4);
	while(!SPI_DMA_IsDone()); 
}
uint8_t KTH71_ReadReg(uint8_t addr, uint8_t *pRegValue)
{
  uint8_t crcflag = 0;
  uint8_t dataSend[2] = {KTH71_READ_REG, addr};
  uint8_t dataBack[2];

  KTH71_SPI_TransmitReceive(dataSend,dataBack,2,2);
  crcflag = KTH71_IsCRCOK(dataBack, 2);
  *pRegValue = dataBack[0];
  return crcflag;
}

uint8_t KTH71_WriteReg(uint8_t addr, uint8_t data)
{
	KTH71_LockReg();
  uint8_t dataSend[3] = {KTH71_WRITE_REG, addr, data};
  uint8_t dataBack = 0;
  KTH71_SPI_TransmitReceive(dataSend,&dataBack,3,1);
  return dataBack;
}
void KTH71_WriteRegToMTP(void)
{
  uint8_t dataSend[3] = {0x22, 0x55, 0xAA};
  SPI_DMA_HalfDuplex_TxStartAsync(dataSend, 3);
	while(!SPI_DMA_IsDone()); 
  LL_mDelay(400);
}

uint8_t KTH71_ReadAngle(uint16_t *pAngle)
{
  uint8_t crcflag = 0;
  uint8_t dataSend = KTH71_READ_ANGLE;
  uint8_t dataBack[3];

  KTH71_SPI_TransmitReceive(&dataSend, dataBack, 1, 3);
  crcflag = KTH71_IsCRCOK(dataBack, 3);
  *pAngle = (dataBack[0] << 8) | dataBack[1];
  return crcflag;
}

